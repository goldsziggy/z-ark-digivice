// Exact vendor type=1 initialization; official Demo.zip SHA256
// ddb55c65b37cc204f071b505abc7636504a657485ae9f3fabcf8bcd9418654aa.
// https://files.waveshare.com/wiki/ESP32-S3-Touch-LCD-2.1/ESP32-S3-Touch-LCD-2.1-Demo.zip
constexpr InitWord initWords[]{
    {false, 0xFF, 0},
    {true, 0x77, 0},
    {true, 0x01, 0},
    {true, 0x00, 0},
    {true, 0x00, 0},
    {true, 0x10, 0},
    {false, 0xC0, 0},
    {true, 0x3B, 0},
    {true, 0x00, 0},
    {false, 0xC1, 0},
    {true, 0x0B, 0},
    {true, 0x02, 0},
    {false, 0xC2, 0},
    {true, 0x07, 0},
    {true, 0x02, 0},
    {false, 0xCC, 0},
    {true, 0x10, 0},
    {false, 0xCD, 0},
    {true, 0x08, 0},
    {false, 0xB0, 0},
    {true, 0x00, 0},
    {true, 0x11, 0},
    {true, 0x16, 0},
    {true, 0x0e, 0},
    {true, 0x11, 0},
    {true, 0x06, 0},
    {true, 0x05, 0},
    {true, 0x09, 0},
    {true, 0x08, 0},
    {true, 0x21, 0},
    {true, 0x06, 0},
    {true, 0x13, 0},
    {true, 0x10, 0},
    {true, 0x29, 0},
    {true, 0x31, 0},
    {true, 0x18, 0},
    {false, 0xB1, 0},
    {true, 0x00, 0},
    {true, 0x11, 0},
    {true, 0x16, 0},
    {true, 0x0e, 0},
    {true, 0x11, 0},
    {true, 0x07, 0},
    {true, 0x05, 0},
    {true, 0x09, 0},
    {true, 0x09, 0},
    {true, 0x21, 0},
    {true, 0x05, 0},
    {true, 0x13, 0},
    {true, 0x11, 0},
    {true, 0x2a, 0},
    {true, 0x31, 0},
    {true, 0x18, 0},
    {false, 0xFF, 0},
    {true, 0x77, 0},
    {true, 0x01, 0},
    {true, 0x00, 0},
    {true, 0x00, 0},
    {true, 0x11, 0},
    {false, 0xB0, 0},
    {true, 0x6d, 0},
    {false, 0xB1, 0},
    {true, 0x37, 0},
    {false, 0xB2, 0},
    {true, 0x81, 0},
    {false, 0xB3, 0},
    {true, 0x80, 0},
    {false, 0xB5, 0},
    {true, 0x43, 0},
    {false, 0xB7, 0},
    {true, 0x85, 0},
    {false, 0xB8, 0},
    {true, 0x20, 0},
    {false, 0xC1, 0},
    {true, 0x78, 0},
    {false, 0xC2, 0},
    {true, 0x78, 0},
    {false, 0xD0, 0},
    {true, 0x88, 0},
    {false, 0xE0, 0},
    {true, 0x00, 0},
    {true, 0x00, 0},
    {true, 0x02, 0},
    {false, 0xE1, 0},
    {true, 0x03, 0},
    {true, 0xA0, 0},
    {true, 0x00, 0},
    {true, 0x00, 0},
    {true, 0x04, 0},
    {true, 0xA0, 0},
    {true, 0x00, 0},
    {true, 0x00, 0},
    {true, 0x00, 0},
    {true, 0x20, 0},
    {true, 0x20, 0},
    {false, 0xE2, 0},
    {true, 0x00, 0},
    {true, 0x00, 0},
    {true, 0x00, 0},
    {true, 0x00, 0},
    {true, 0x00, 0},
    {true, 0x00, 0},
    {true, 0x00, 0},
    {true, 0x00, 0},
    {true, 0x00, 0},
    {true, 0x00, 0},
    {true, 0x00, 0},
    {true, 0x00, 0},
    {true, 0x00, 0},
    {false, 0xE3, 0},
    {true, 0x00, 0},
    {true, 0x00, 0},
    {true, 0x11, 0},
    {true, 0x00, 0},
    {false, 0xE4, 0},
    {true, 0x22, 0},
    {true, 0x00, 0},
    {false, 0xE5, 0},
    {true, 0x05, 0},
    {true, 0xEC, 0},
    {true, 0xA0, 0},
    {true, 0xA0, 0},
    {true, 0x07, 0},
    {true, 0xEE, 0},
    {true, 0xA0, 0},
    {true, 0xA0, 0},
    {true, 0x00, 0},
    {true, 0x00, 0},
    {true, 0x00, 0},
    {true, 0x00, 0},
    {true, 0x00, 0},
    {true, 0x00, 0},
    {true, 0x00, 0},
    {true, 0x00, 0},
    {false, 0xE6, 0},
    {true, 0x00, 0},
    {true, 0x00, 0},
    {true, 0x11, 0},
    {true, 0x00, 0},
    {false, 0xE7, 0},
    {true, 0x22, 0},
    {true, 0x00, 0},
    {false, 0xE8, 0},
    {true, 0x06, 0},
    {true, 0xED, 0},
    {true, 0xA0, 0},
    {true, 0xA0, 0},
    {true, 0x08, 0},
    {true, 0xEF, 0},
    {true, 0xA0, 0},
    {true, 0xA0, 0},
    {true, 0x00, 0},
    {true, 0x00, 0},
    {true, 0x00, 0},
    {true, 0x00, 0},
    {true, 0x00, 0},
    {true, 0x00, 0},
    {true, 0x00, 0},
    {true, 0x00, 0},
    {false, 0xEB, 0},
    {true, 0x00, 0},
    {true, 0x00, 0},
    {true, 0x40, 0},
    {true, 0x40, 0},
    {true, 0x00, 0},
    {true, 0x00, 0},
    {true, 0x00, 0},
    {false, 0xED, 0},
    {true, 0xFF, 0},
    {true, 0xFF, 0},
    {true, 0xFF, 0},
    {true, 0xBA, 0},
    {true, 0x0A, 0},
    {true, 0xBF, 0},
    {true, 0x45, 0},
    {true, 0xFF, 0},
    {true, 0xFF, 0},
    {true, 0x54, 0},
    {true, 0xFB, 0},
    {true, 0xA0, 0},
    {true, 0xAB, 0},
    {true, 0xFF, 0},
    {true, 0xFF, 0},
    {true, 0xFF, 0},
    {false, 0xEF, 0},
    {true, 0x10, 0},
    {true, 0x0D, 0},
    {true, 0x04, 0},
    {true, 0x08, 0},
    {true, 0x3F, 0},
    {true, 0x1F, 0},
    {false, 0xFF, 0},
    {true, 0x77, 0},
    {true, 0x01, 0},
    {true, 0x00, 0},
    {true, 0x00, 0},
    {true, 0x13, 0},
    {false, 0xEF, 0},
    {true, 0x08, 0},
    {false, 0xFF, 0},
    {true, 0x77, 0},
    {true, 0x01, 0},
    {true, 0x00, 0},
    {true, 0x00, 0},
    {true, 0x00, 0},
    {false, 0x36, 0},
    {true, 0x00, 0},
    {false, 0x3A, 0},
    {true, 0x66, 0},
    {false, 0x11, 0},
    {false, 0, 480},
    {false, 0x20, 0},
    {false, 0, 120},
    {false, 0x29, 0},
};
