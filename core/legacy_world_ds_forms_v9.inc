// Frozen rules9/schema12 from e6f3523 before two-profile correction.
// Generated by scripts/generate-world-ds-profiles.py; do not edit.
    {67,1067,Stage::Fresh,0,{0,0},1,0,"Chibomon","tide","Chibo Nudge","Chibo Tumble","Dew Wink",nullptr,{64,8,6,8,6},{4,2,1,2,1},CombatTier::Fresh},
    {68,1068,Stage::Fresh,0,{0,0},1,0,"Kuramon","neutral","Kura Blink Jab","Kura Eyeball Roll","Kura Static Veil",nullptr,{64,5,5,12,6},{4,1,1,3,1},CombatTier::Fresh},
    {69,1069,Stage::Fresh,0,{0,0},1,0,"Poyomon","tide","Poyo Bob","Poyo Foam Press","Poyo Tide Halo",nullptr,{72,6,5,6,9},{8,1,1,1,2},CombatTier::Fresh},
    {70,1070,Stage::Fresh,0,{0,0},1,0,"Puttimon","neutral","Putti Wing Tap","Putti Cloud Drop","Putti Lantern Gleam",nullptr,{72,6,5,6,9},{8,1,1,1,2},CombatTier::Fresh},
    {71,1071,Stage::InTraining,0,{0,0},1,0,"Dorimon","neutral","Dori Horn Jab","Dori Spring Ram","Dori Silver Flicker",nullptr,{80,16,9,9,8},{4,3,1,1,1},CombatTier::InTraining},
    {72,1072,Stage::InTraining,0,{0,0},1,0,"Kapurimon","neutral","Kapu Shell Tap","Kapu Helmet Roll","Kapu Copper Glow",nullptr,{88,10,12,10,8},{8,1,2,1,1},CombatTier::InTraining},
    {73,1073,Stage::InTraining,0,{0,0},1,0,"Koromon","neutral","Koro Hop","Koro Bounce Press","Koro Amber Bubble",nullptr,{80,12,9,12,9},{4,2,1,2,1},CombatTier::InTraining},
    {74,1074,Stage::InTraining,0,{0,0},1,0,"Pagumon","neutral","Pagu Ear Flick","Pagu Somersault","Pagu Dusk Mist",nullptr,{80,9,8,16,9},{4,1,1,3,1},CombatTier::InTraining},
    {75,1075,Stage::InTraining,0,{0,0},1,0,"Tanemon","grove","Tane Root Tap","Tane Sprout Roll","Tane Dew Garland",nullptr,{88,10,8,10,12},{8,1,1,1,2},CombatTier::InTraining},
    {76,1076,Stage::InTraining,0,{0,0},1,0,"Tokomon","neutral","Toko Nip","Toko Leap Chomp","Toko Pearl Flash",nullptr,{80,16,9,9,8},{4,3,1,1,1},CombatTier::InTraining},
    {77,1077,Stage::InTraining,0,{0,0},1,0,"Tsunomon","grove","Tsuno Horn Nudge","Tsuno Bramble Roll","Tsuno Moss Glimmer",nullptr,{88,10,12,10,8},{8,1,2,1,1},CombatTier::InTraining},
    {78,1078,Stage::Rookie,0,{121,0},1,0,"Armadillomon","grove","Armadillo Paw","Armadillo Drum Roll","Armadillo Dust Halo",nullptr,{112,16,17,16,12},{8,1,2,1,1},CombatTier::Rookie},
    {79,1079,Stage::Rookie,0,{0,0},1,0,"Aruraumon","grove","Arura Stem Slap","Arura Thorn Wheel","Arura Violet Haze",nullptr,{104,15,13,22,13},{4,1,1,3,1},CombatTier::Rookie},
    {80,1080,Stage::Rookie,0,{157,0},1,0,"Betamon","tide","Beta Fin Flick","Beta Wave Lunge","Beta Ripple Arc",nullptr,{104,18,14,18,13},{4,2,1,2,1},CombatTier::Rookie},
    {81,1081,Stage::Rookie,0,{125,0},1,0,"Biyomon","grove","Biyo Feather Jab","Biyo Wing Rush","Biyo Petal Draft",nullptr,{104,22,14,15,12},{4,3,1,1,1},CombatTier::Rookie},
    {82,1082,Stage::Rookie,0,{0,0},1,0,"BlackAgumon","ember","Black Agu Rake","Black Agu Coal Ram","Black Agu Ash Swirl",nullptr,{104,22,14,15,12},{4,3,1,1,1},CombatTier::Rookie},
    {83,1083,Stage::Rookie,0,{0,0},1,0,"Crabmon","tide","Crab Pincer Clip","Crab Shell Hammer","Crab Brine Spiral",nullptr,{112,16,17,16,12},{8,1,2,1,1},CombatTier::Rookie},
    {84,1084,Stage::Rookie,0,{0,0},1,0,"DemiDevimon","neutral","Demi Wing Nick","Demi Midnight Dive","Demi Violet Echo",nullptr,{104,15,13,22,13},{4,1,1,3,1},CombatTier::Rookie},
    {85,1085,Stage::Rookie,0,{130,0},1,0,"Dorumon","neutral","Doru Paw Swipe","Doru Crest Rush","Doru Quartz Pulse",nullptr,{104,18,14,18,13},{4,2,1,2,1},CombatTier::Rookie},
    {86,1086,Stage::Rookie,0,{0,0},1,0,"DotAgumon","ember","Dot Agu Bit Claw","Dot Agu Block Drop","Dot Agu Ember Pixel",nullptr,{104,18,14,18,13},{4,2,1,2,1},CombatTier::Rookie},
    {87,1087,Stage::Rookie,0,{0,0},1,0,"DotFalcomon","grove","Dot Falco Bit Peck","Dot Falco Tile Dive","Dot Falco Wind Pixel",nullptr,{104,22,14,15,12},{4,3,1,1,1},CombatTier::Rookie},
    {88,1088,Stage::Rookie,0,{156,0},1,0,"Dracmon","neutral","Drac Talon Flick","Drac Mask Pounce","Drac Indigo Wink",nullptr,{104,15,13,22,13},{4,1,1,3,1},CombatTier::Rookie},
    {89,1089,Stage::Rookie,0,{150,0},1,0,"Falcomon","grove","Falco Hook Peck","Falco Crest Dive","Falco Wind Stitch",nullptr,{104,22,14,15,12},{4,3,1,1,1},CombatTier::Rookie},
    {90,1090,Stage::Rookie,0,{0,0},1,0,"Floramon","grove","Flora Stem Flick","Flora Root Twist","Flora Pollen Lantern",nullptr,{112,16,13,16,16},{8,1,1,1,2},CombatTier::Rookie},
    {91,1091,Stage::Rookie,0,{133,0},1,0,"Gaomon","neutral","Gao Palm Snap","Gao Shoulder Rush","Gao Ring Spark",nullptr,{104,22,14,15,12},{4,3,1,1,1},CombatTier::Rookie},
    {92,1092,Stage::Rookie,0,{0,0},1,0,"Gizamon","tide","Giza Fin Hook","Giza Torrent Slam","Giza Brine Flash",nullptr,{104,22,14,15,12},{4,3,1,1,1},CombatTier::Rookie},
    {93,1093,Stage::Rookie,0,{0,0},1,0,"Goburimon","grove","Gobu Knuckle Tap","Gobu Stump Hammer","Gobu Leaf Rattle",nullptr,{104,22,14,15,12},{4,3,1,1,1},CombatTier::Rookie},
    {94,1094,Stage::Rookie,0,{0,0},1,0,"Gotsumon","grove","Gotsu Stone Jab","Gotsu Quarry Roll","Gotsu Flint Glint",nullptr,{112,16,17,16,12},{8,1,2,1,1},CombatTier::Rookie},
    {95,1095,Stage::Rookie,0,{139,0},1,0,"Guilmon","ember","Guil Talon Cut","Guil Tail Crush","Guil Furnace Wink",nullptr,{104,22,14,15,12},{4,3,1,1,1},CombatTier::Rookie},
    {96,1096,Stage::Rookie,0,{140,0},1,0,"Hagurumon","neutral","Haguru Cog Tap","Haguru Gear Press","Haguru Copper Arc",nullptr,{112,16,17,16,12},{8,1,2,1,1},CombatTier::Rookie},
    {97,1097,Stage::Rookie,0,{123,0},1,0,"Hawkmon","grove","Hawk Feather Cut","Hawk Wing Pummel","Hawk Horizon Gust",nullptr,{104,22,14,15,12},{4,3,1,1,1},CombatTier::Rookie},
    {98,1098,Stage::Rookie,0,{141,0},1,0,"Kamemon","tide","Kame Shell Jab","Kame Basin Roll","Kame Ripple Beacon",nullptr,{112,16,17,16,12},{8,1,2,1,1},CombatTier::Rookie},
    {99,1099,Stage::Rookie,0,{146,0},1,0,"Keramon","neutral","Kera Palm Stretch","Kera Coil Pounce","Kera Bit Lantern",nullptr,{104,15,13,22,13},{4,1,1,3,1},CombatTier::Rookie},
    {100,1100,Stage::Rookie,0,{0,0},1,0,"Kotemon","neutral","Kote Reed Cut","Kote Oak Cleave","Kote Spirit Ribbon",nullptr,{112,16,13,16,16},{8,1,1,1,2},CombatTier::Rookie},
    {101,1101,Stage::Rookie,0,{153,0},1,0,"Kudamon","neutral","Kuda Tail Flick","Kuda Ribbon Crush","Kuda Dawn Chime",nullptr,{112,16,13,16,16},{8,1,1,1,2},CombatTier::Rookie},
    {102,1102,Stage::Rookie,0,{0,0},1,0,"Kumamon","grove","Kuma Paw Hook","Kuma Cap Rush","Kuma Honey Spark",nullptr,{104,22,14,15,12},{4,3,1,1,1},CombatTier::Rookie},
    {103,1103,Stage::Rookie,0,{163,0},1,0,"Lalamon","grove","Lala Leaf Tap","Lala Seed Press","Lala Orchard Chord",nullptr,{104,15,13,22,13},{4,1,1,3,1},CombatTier::Rookie},
    {104,1104,Stage::Rookie,0,{0,0},1,0,"Lopmon","grove","Lop Ear Sweep","Lop Clover Roll","Lop Meadow Chime",nullptr,{112,16,13,16,16},{8,1,1,1,2},CombatTier::Rookie},
    {105,1105,Stage::Rookie,0,{0,0},1,0,"Muchomon","ember","Mucho Beak Snap","Mucho Sunset Dive","Mucho Coral Flare",nullptr,{104,18,14,18,13},{4,2,1,2,1},CombatTier::Rookie},
    {106,1106,Stage::Rookie,0,{0,0},1,0,"Otamamon","tide","Otama Tail Tap","Otama Lily Lunge","Otama Ripple Chord",nullptr,{104,15,13,22,13},{4,1,1,3,1},CombatTier::Rookie},
    {107,1107,Stage::Rookie,0,{0,0},1,0,"PawnChessmon Black","neutral","Black Pawn Spear","Black Pawn File Rush","Black Pawn Rune Grid",nullptr,{112,16,17,16,12},{8,1,2,1,1},CombatTier::Rookie},
    {108,1108,Stage::Rookie,0,{0,0},1,0,"PawnChessmon White","neutral","White Pawn Point","White Pawn Rank Ram","White Pawn Pearl Grid",nullptr,{112,16,13,16,16},{8,1,1,1,2},CombatTier::Rookie},
    {109,1109,Stage::Rookie,0,{0,0},1,0,"Penguinmon","tide","Penguin Flipper Tap","Penguin Ice Slide","Penguin Frost Beads",nullptr,{104,18,14,18,13},{4,2,1,2,1},CombatTier::Rookie},
    {110,1110,Stage::Rookie,0,{135,0},1,0,"Salamon","neutral","Sala Paw Bop","Sala Bell Tackle","Sala Dawn Thread",nullptr,{112,16,13,16,16},{8,1,1,1,2},CombatTier::Rookie},
    {111,1111,Stage::Rookie,0,{0,0},1,0,"ShadowToyAgumon","neutral","Shadow Toy Peg Jab","Shadow Toy Block Ram","Shadow Toy Prism Hex",nullptr,{104,15,13,22,13},{4,1,1,3,1},CombatTier::Rookie},
    {112,1112,Stage::Rookie,0,{0,0},1,0,"SnowAgumon","tide","Snow Agu Claw","Snow Agu Drift Ram","Snow Agu Rime Stars",nullptr,{112,16,17,16,12},{8,1,2,1,1},CombatTier::Rookie},
    {113,1113,Stage::Rookie,0,{0,0},1,0,"Tapirmon","neutral","Tapir Trunk Nudge","Tapir Pillow Roll","Tapir Slumber Spark",nullptr,{112,16,13,16,16},{8,1,1,1,2},CombatTier::Rookie},
    {114,1114,Stage::Rookie,0,{134,0},1,0,"Terriermon","grove","Terrier Ear Snap","Terrier Clover Dive","Terrier Breeze Beads",nullptr,{104,18,14,18,13},{4,2,1,2,1},CombatTier::Rookie},
    {115,1115,Stage::Rookie,0,{0,0},1,0,"ToyAgumon","neutral","Toy Agu Peg Tap","Toy Agu Brick Press","Toy Agu Prism Spray",nullptr,{112,16,17,16,12},{8,1,2,1,1},CombatTier::Rookie},
    {116,1116,Stage::Rookie,0,{0,0},1,0,"Tsukaimon","neutral","Tsukai Wing Nick","Tsukai Night Barrel","Tsukai Plum Haze",nullptr,{104,15,13,22,13},{4,1,1,3,1},CombatTier::Rookie},
    {117,1117,Stage::Rookie,0,{131,0},1,0,"Veemon","tide","Vee Claw Dash","Vee Crest Smash","Vee Sapphire Arc",nullptr,{104,22,14,15,12},{4,3,1,1,1},CombatTier::Rookie},
    {118,1118,Stage::Rookie,0,{161,0},1,0,"Wormmon","grove","Worm Antenna Tap","Worm Cocoon Roll","Worm Silk Lantern",nullptr,{112,16,13,16,16},{8,1,1,1,2},CombatTier::Rookie},
    {119,1119,Stage::Champion,0,{0,0},5,20,"Airdramon","grove","Air Dra Tail Lash","Air Dra Cyclone Ram","Air Dra Cloud Spiral",nullptr,{136,22,22,37,25},{4,1,1,3,1},CombatTier::Champion},
    {120,1120,Stage::Champion,0,{0,0},5,20,"Akatorimon","ember","Akatori Beak Jab","Akatori Crest Slam","Akatori Sunrise Flare",nullptr,{136,28,24,29,25},{4,2,1,2,1},CombatTier::Champion},
    {121,1078,Stage::Champion,78,{0,0},5,20,"Ankylomon","grove","Ankylo Horn Cut","Ankylo Tail Anvil","Ankylo Quarry Gleam",nullptr,{152,24,30,25,23},{8,1,2,1,1},CombatTier::Champion},
    {122,1122,Stage::Champion,0,{0,0},5,20,"Apemon","grove","Ape Staff Sweep","Ape Bamboo Hammer","Ape Jade Shimmer",nullptr,{136,36,24,23,23},{4,3,1,1,1},CombatTier::Champion},
    {123,1097,Stage::Champion,97,{207,0},5,20,"Aquilamon","grove","Aquila Talon Cross","Aquila Gale Dive","Aquila Horizon Ring",nullptr,{136,36,24,23,23},{4,3,1,1,1},CombatTier::Champion},
    {124,1124,Stage::Champion,0,{0,0},5,20,"Bakemon","neutral","Bake Cloth Flick","Bake Phantom Drop","Bake Lantern Shroud",nullptr,{136,22,22,37,25},{4,1,1,3,1},CombatTier::Champion},
    {125,1081,Stage::Champion,81,{183,0},5,20,"Birdramon","ember","Birdra Talon Rake","Birdra Furnace Dive","Birdra Ember Garland",nullptr,{136,36,24,23,23},{4,3,1,1,1},CombatTier::Champion},
    {126,1126,Stage::Champion,0,{0,0},5,20,"DarkLizardmon","ember","Dark Lizard Rake","Dark Lizard Coal Ram","Dark Lizard Ash Halo",nullptr,{136,22,22,37,25},{4,1,1,3,1},CombatTier::Champion},
    {127,1127,Stage::Champion,0,{0,0},5,20,"DarkTyrannomon","ember","Dark Tyranno Bite","Dark Tyranno Heel","Dark Tyranno Cinder",nullptr,{136,36,24,23,23},{4,3,1,1,1},CombatTier::Champion},
    {128,1128,Stage::Champion,0,{0,0},5,20,"Diatrymon","grove","Diatry Beak Cut","Diatry Boulder Dash","Diatry Dust Vortex",nullptr,{136,36,24,23,23},{4,3,1,1,1},CombatTier::Champion},
    {129,1129,Stage::Champion,0,{0,0},5,20,"Dinohyumon","neutral","Dino Blade Cross","Dino Cleaver Rush","Dino Steel Gleam",nullptr,{136,36,24,23,23},{4,3,1,1,1},CombatTier::Champion},
    {130,1085,Stage::Champion,85,{179,0},5,20,"Dorugamon","neutral","Doruga Talon Sweep","Doruga Crest Break","Doruga Quartz Gale",nullptr,{136,28,24,29,25},{4,2,1,2,1},CombatTier::Champion},
    {131,1117,Stage::Champion,117,{201,0},5,20,"ExVeemon","tide","ExVee Elbow Rush","ExVee Wing Driver","ExVee Azure Cross",nullptr,{136,36,24,23,23},{4,3,1,1,1},CombatTier::Champion},
    {132,1132,Stage::Champion,0,{0,0},5,20,"Flarerizamon","ember","Flare Lizard Claw","Flare Lizard Ram","Flare Lizard Torch",nullptr,{136,22,22,37,25},{4,1,1,3,1},CombatTier::Champion},
    {133,1091,Stage::Champion,91,{191,0},5,20,"Gaogamon","neutral","Gaoga Paw Cross","Gaoga Shoulder Gale","Gaoga Ring Flurry",nullptr,{136,36,24,23,23},{4,3,1,1,1},CombatTier::Champion},
    {134,1114,Stage::Champion,114,{204,0},5,20,"Gargomon","neutral","Gargo Knuckle Tap","Gargo Barrel Ram","Gargo Copper Spray",nullptr,{136,36,24,23,23},{4,3,1,1,1},CombatTier::Champion},
    {135,1110,Stage::Champion,110,{167,0},5,20,"Gatomon","neutral","Gato Paw Cross","Gato Tail Vault","Gato Golden Thread",nullptr,{152,24,22,25,31},{8,1,1,1,2},CombatTier::Champion},
    {136,1136,Stage::Champion,0,{0,0},5,20,"Gekomon","tide","Geko Palm Slap","Geko Bass Tackle","Geko Reed Crescendo",nullptr,{136,22,22,37,25},{4,1,1,3,1},CombatTier::Champion},
    {137,1137,Stage::Champion,0,{0,0},5,20,"GeoGreymon","ember","Geo Grey Horn Cut","Geo Grey Crest Rush","Geo Grey Furnace Arc",nullptr,{136,36,24,23,23},{4,3,1,1,1},CombatTier::Champion},
    {138,1138,Stage::Champion,0,{0,0},5,20,"Grizzmon","grove","Grizz Paw Hook","Grizz Timber Press","Grizz Amber Roar",nullptr,{136,36,24,23,23},{4,3,1,1,1},CombatTier::Champion},
    {139,1095,Stage::Champion,95,{212,0},5,20,"Growlmon","ember","Growl Talon Cut","Growl Blade Driver","Growl Cinder Pulse",nullptr,{136,36,24,23,23},{4,3,1,1,1},CombatTier::Champion},
    {140,1096,Stage::Champion,96,{166,0},5,20,"Guardromon","neutral","Guardro Rivet Jab","Guardro Foundry Ram","Guardro Beacon Arc",nullptr,{152,24,30,25,23},{8,1,2,1,1},CombatTier::Champion},
    {141,1098,Stage::Champion,98,{0,0},5,20,"Gwappamon","tide","Gwappa Paddle Tap","Gwappa Drum Roll","Gwappa Lagoon Chord",nullptr,{136,22,22,37,25},{4,1,1,3,1},CombatTier::Champion},
    {142,1142,Stage::Champion,0,{0,0},5,20,"Hookmon","tide","Hook Deck Cut","Hook Anchor Drop","Hook Brine Lantern",nullptr,{136,36,24,23,23},{4,3,1,1,1},CombatTier::Champion},
    {143,1143,Stage::Champion,0,{0,0},5,20,"Icemon","tide","Ice Shard Jab","Ice Glacier Roll","Ice Polar Glimmer",nullptr,{152,24,30,25,23},{8,1,2,1,1},CombatTier::Champion},
    {144,1144,Stage::Champion,0,{0,0},5,20,"Kiwimon","grove","Kiwi Beak Tap","Kiwi Root Dash","Kiwi Orchard Puff",nullptr,{136,28,24,29,25},{4,2,1,2,1},CombatTier::Champion},
    {145,1145,Stage::Champion,0,{0,0},5,20,"Kokatorimon","grove","Kokatori Beak Hook","Kokatori Crest Press","Kokatori Jade Wink",nullptr,{136,36,24,23,23},{4,3,1,1,1},CombatTier::Champion},
    {146,1099,Stage::Champion,99,{185,0},5,20,"Kurisarimon","neutral","Kurisari Tendril","Kurisari Shell Press","Kurisari Bit Shroud",nullptr,{152,24,30,25,23},{8,1,2,1,1},CombatTier::Champion},
    {147,1147,Stage::Champion,0,{0,0},5,20,"Minotarumon","grove","Minotaur Horn Jab","Minotaur Stone Crush","Minotaur Dust Halo",nullptr,{136,36,24,23,23},{4,3,1,1,1},CombatTier::Champion},
    {148,1148,Stage::Champion,0,{0,0},5,20,"Numemon","neutral","Nume Slime Slap","Nume Muck Barrel","Nume Bog Bubbles",nullptr,{152,24,30,25,23},{8,1,2,1,1},CombatTier::Champion},
    {149,1149,Stage::Champion,0,{0,0},5,20,"Ogremon","grove","Ogre Club Sweep","Ogre Boulder Split","Ogre Moss Rumble",nullptr,{136,36,24,23,23},{4,3,1,1,1},CombatTier::Champion},
    {150,1089,Stage::Champion,89,{213,0},5,20,"Peckmon","grove","Peck Heel Snap","Peck Crest Driver","Peck Wind Ribbons",nullptr,{136,36,24,23,23},{4,3,1,1,1},CombatTier::Champion},
    {151,1151,Stage::Champion,0,{0,0},5,20,"PlatinumSukamon","neutral","Platina Slime Tap","Platina Ingots Roll","Platina Mirror Haze",nullptr,{152,24,30,25,23},{8,1,2,1,1},CombatTier::Champion},
    {152,1152,Stage::Champion,0,{0,0},5,20,"Raremon","neutral","Rare Ooze Swipe","Rare Muck Avalanche","Rare Violet Vapour",nullptr,{152,24,30,25,23},{8,1,2,1,1},CombatTier::Champion},
    {153,1101,Stage::Champion,101,{211,0},5,20,"Reppamon","grove","Reppa Tail Cross","Reppa Branch Rush","Reppa Gale Lattice",nullptr,{136,36,24,23,23},{4,3,1,1,1},CombatTier::Champion},
    {154,1154,Stage::Champion,0,{0,0},5,20,"Reptiledramon","neutral","Reptile Talon Cut","Reptile Alloy Ram","Reptile Chrome Arc",nullptr,{136,36,24,23,23},{4,3,1,1,1},CombatTier::Champion},
    {155,1155,Stage::Champion,0,{0,0},5,20,"Roachmon","grove","Roach Leg Hook","Roach Shell Driver","Roach Copper Dust",nullptr,{136,36,24,23,23},{4,3,1,1,1},CombatTier::Champion},
    {156,1088,Stage::Champion,88,{193,0},5,20,"Sangloupmon","neutral","Sangloup Fang Cut","Sangloup Night Rush","Sangloup Crimson Haze",nullptr,{136,22,22,37,25},{4,1,1,3,1},CombatTier::Champion},
    {157,1080,Stage::Champion,80,{196,0},5,20,"Seadramon","tide","Sea Dra Tail Sweep","Sea Dra Reef Crush","Sea Dra Lagoon Coil",nullptr,{136,28,24,29,25},{4,2,1,2,1},CombatTier::Champion},
    {158,1158,Stage::Champion,0,{0,0},5,20,"Seasarmon","neutral","Seasar Paw Cross","Seasar Bell Rush","Seasar Golden Mist",nullptr,{152,24,22,25,31},{8,1,1,1,2},CombatTier::Champion},
    {159,1159,Stage::Champion,0,{0,0},5,20,"Sorcerymon","tide","Sorcery Staff Tap","Sorcery Frost Hammer","Sorcery Rime Runes",nullptr,{136,22,22,37,25},{4,1,1,3,1},CombatTier::Champion},
    {160,1160,Stage::Champion,0,{0,0},5,20,"Starmon","neutral","Star Point Jab","Star Meteor Press","Star Orbit Garland",nullptr,{152,24,22,25,31},{8,1,1,1,2},CombatTier::Champion},
    {161,1118,Stage::Champion,118,{177,0},5,20,"Stingmon","grove","Sting Wrist Cut","Sting Thorn Driver","Sting Emerald Trail",nullptr,{136,36,24,23,23},{4,3,1,1,1},CombatTier::Champion},
    {162,1162,Stage::Champion,0,{0,0},5,20,"Sukamon","neutral","Suka Slime Jab","Suka Muck Boulder","Suka Amber Haze",nullptr,{152,24,30,25,23},{8,1,2,1,1},CombatTier::Champion},
    {163,1103,Stage::Champion,103,{189,0},5,20,"Sunflowmon","grove","Sunflow Stem Swipe","Sunflow Root Wheel","Sunflow Pollen Corona",nullptr,{136,22,22,37,25},{4,1,1,3,1},CombatTier::Champion},
    {164,1164,Stage::Champion,0,{0,0},5,20,"Vegiemon","grove","Vegi Tendril Tap","Vegi Root Knot","Vegi Orchard Fog",nullptr,{136,22,22,37,25},{4,1,1,3,1},CombatTier::Champion},
    {165,1165,Stage::Champion,0,{0,0},5,20,"Vilemon","neutral","Vile Wing Rake","Vile Dusk Pounce","Vile Midnight Chime",nullptr,{136,22,22,37,25},{4,1,1,3,1},CombatTier::Champion},
    {166,1096,Stage::Ultimate,140,{243,0},10,50,"Andromon","neutral","Servo Knuckle","Piston Bodycheck","Circuit Lance",nullptr,{200,38,47,39,36},{8,1,2,1,1},CombatTier::Ultimate},
    {167,1110,Stage::Ultimate,135,{0,0},10,50,"Angewomon","neutral","Feather Palm","Halo Descent","Sanctuary Arrow",nullptr,{200,38,35,39,48},{8,1,1,1,2},CombatTier::Ultimate},
    {168,1168,Stage::Ultimate,0,{0,0},10,50,"Antylamon","grove","Rabbit Palm","Moonbound Heel","Jade Spiral",nullptr,{176,44,38,45,39},{4,2,1,2,1},CombatTier::Ultimate},
    {169,1169,Stage::Ultimate,0,{0,0},10,50,"Arukenimon","grove","Silken Hook","Webbed Pounce","Marionette Mist",nullptr,{176,35,35,57,39},{4,1,1,3,1},CombatTier::Ultimate},
    {170,1170,Stage::Ultimate,0,{0,0},10,50,"BlackRapidmon","neutral","Onyx Cuff","Nightguard Ram","Obsidian Pulse",nullptr,{200,38,35,39,48},{8,1,1,1,2},CombatTier::Ultimate},
    {171,1171,Stage::Ultimate,0,{0,0},10,50,"BlackWarGrowlmon","ember","Sootsteel Claw","Black Reactor Tackle","Charred Plasma",nullptr,{200,38,47,39,36},{8,1,2,1,1},CombatTier::Ultimate},
    {172,1172,Stage::Ultimate,0,{0,0},10,50,"BlackWereGarurumon","tide","Midnight Wolf Kick","Shadow Crescent Heel","Frostbite Howl",nullptr,{176,56,38,36,36},{4,3,1,1,1},CombatTier::Ultimate},
    {173,1173,Stage::Ultimate,0,{0,0},10,50,"Blossomon","grove","Bramble Rake","Bloom Wheel Crush","Pollen Lantern",nullptr,{200,38,47,39,36},{8,1,2,1,1},CombatTier::Ultimate},
    {174,1174,Stage::Ultimate,0,{0,0},10,50,"Cyberdramon","neutral","Data Ripper","Cyber Talon Dive","Error Surge",nullptr,{176,56,38,36,36},{4,3,1,1,1},CombatTier::Ultimate},
    {175,1175,Stage::Ultimate,0,{0,0},10,50,"Deramon","grove","Crested Peck","Garden Wing Press","Fernlight Veil",nullptr,{200,38,35,39,48},{8,1,1,1,2},CombatTier::Ultimate},
    {176,1176,Stage::Ultimate,0,{0,0},10,50,"Digitamamon","neutral","Eggshell Bump","Shellbound Slam","Dreamshell Spark",nullptr,{200,38,47,39,36},{8,1,2,1,1},CombatTier::Ultimate},
    {177,1118,Stage::Ultimate,161,{0,0},10,50,"Dinobeemon","grove","Stinger Claw","Predator Wingrush","Venomlight Ray",nullptr,{176,56,38,36,36},{4,3,1,1,1},CombatTier::Ultimate},
    {178,1178,Stage::Ultimate,0,{0,0},10,50,"Divermon","tide","Harpoon Jab","Deepsea Shoulder","Pressure Ring",nullptr,{176,44,38,45,39},{4,2,1,2,1},CombatTier::Ultimate},
    {179,1085,Stage::Ultimate,130,{234,0},10,50,"DoruGreymon","neutral","Iron Fur Rake","Doru Tailbreaker","Meteor Code",nullptr,{176,56,38,36,36},{4,3,1,1,1},CombatTier::Ultimate},
    {180,1180,Stage::Ultimate,0,{0,0},10,50,"Dragomon","tide","Abyss Tendril","Tentacle Undertow","Sunken Invocation",nullptr,{176,35,35,57,39},{4,1,1,3,1},CombatTier::Ultimate},
    {181,1181,Stage::Ultimate,0,{0,0},10,50,"Etemon","ember","Stage Elbow","Encore Bodyslam","Distortion Chorus",nullptr,{176,44,38,45,39},{4,2,1,2,1},CombatTier::Ultimate},
    {182,1182,Stage::Ultimate,0,{0,0},10,50,"Garbagemon","grove","Scrap Lid Swipe","Trash Barrel Crush","Sludge Comet",nullptr,{200,38,47,39,36},{8,1,2,1,1},CombatTier::Ultimate},
    {183,1081,Stage::Ultimate,125,{261,0},10,50,"Garudamon","ember","Eagle Talon","Sunwing Tackle","Crimson Updraft",nullptr,{176,56,38,36,36},{4,3,1,1,1},CombatTier::Ultimate},
    {184,1184,Stage::Ultimate,0,{0,0},10,50,"Gigadramon","neutral","Giga Metal Claw","Armored Skycrash","Siege Cluster",nullptr,{200,38,47,39,36},{8,1,2,1,1},CombatTier::Ultimate},
    {185,1099,Stage::Ultimate,146,{233,0},10,50,"Infermon","neutral","Cable Fang","Virus Bodydrill","Firewall Rupture",nullptr,{176,35,35,57,39},{4,1,1,3,1},CombatTier::Ultimate},
    {186,1186,Stage::Ultimate,0,{0,0},10,50,"Kimeramon","neutral","Chimera Rake","Composite Stampede","Hybrid Ruinbeam",nullptr,{176,44,38,45,39},{4,2,1,2,1},CombatTier::Ultimate},
    {187,1187,Stage::Ultimate,0,{0,0},10,50,"Kyukimon","grove","Sickle Sweep","Whirlwind Scissor","Petal Razor Gale",nullptr,{176,56,38,36,36},{4,3,1,1,1},CombatTier::Ultimate},
    {188,1188,Stage::Ultimate,0,{0,0},10,50,"LadyDevimon","neutral","Dusk Nail","Blackwing Lunge","Velvet Nightflame",nullptr,{176,35,35,57,39},{4,1,1,3,1},CombatTier::Ultimate},
    {189,1103,Stage::Ultimate,163,{0,0},10,50,"Lilamon","grove","Lilac Fan","Petal Pirouette","Nectar Starfall",nullptr,{176,35,35,57,39},{4,1,1,3,1},CombatTier::Ultimate},
    {190,1190,Stage::Ultimate,0,{0,0},10,50,"Lucemon Chaos Mode","neutral","Fallen Halo Fist","Judgment Knee","Dawnless Mandala",nullptr,{176,35,35,57,39},{4,1,1,3,1},CombatTier::Ultimate},
    {191,1091,Stage::Ultimate,133,{0,0},10,50,"MachGaogamon","neutral","Jet Boxer Jab","Turbine Cross","Sonic Slipstream",nullptr,{176,56,38,36,36},{4,3,1,1,1},CombatTier::Ultimate},
    {192,1192,Stage::Ultimate,0,{0,0},10,50,"Mamemon","neutral","Tiny Iron Jab","Orbital Knuckle","Pocket Burst",nullptr,{176,44,38,45,39},{4,2,1,2,1},CombatTier::Ultimate},
    {193,1088,Stage::Ultimate,156,{0,0},10,50,"Matadormon","neutral","Crimson Rapier","Cape Vault Thrust","Nocturne Petals",nullptr,{176,56,38,36,36},{4,3,1,1,1},CombatTier::Ultimate},
    {194,1194,Stage::Ultimate,0,{0,0},10,50,"Megadramon","ember","Missile Claw","Steel Dragon Rush","Payload Inferno",nullptr,{176,56,38,36,36},{4,3,1,1,1},CombatTier::Ultimate},
    {195,1195,Stage::Ultimate,0,{0,0},10,50,"MegaKabuterimon Blue","tide","Cobalt Horn","Blue Carapace Ram","Azure Volt Ring",nullptr,{200,38,35,39,48},{8,1,1,1,2},CombatTier::Ultimate},
    {196,1080,Stage::Ultimate,157,{257,240},10,50,"MegaSeadramon","tide","Thunderfin Lash","Stormcoil Crush","Ocean Voltage",nullptr,{176,35,35,57,39},{4,1,1,3,1},CombatTier::Ultimate},
    {197,1197,Stage::Ultimate,0,{0,0},10,50,"MetalMamemon","neutral","Clamp Knuckle","Foundry Punch","Micro Cannon Arc",nullptr,{200,38,47,39,36},{8,1,2,1,1},CombatTier::Ultimate},
    {198,1198,Stage::Ultimate,0,{0,0},10,50,"Meteormon","neutral","Crater Knuckle","Meteor Shoulderfall","Stardust Shards",nullptr,{200,38,47,39,36},{8,1,2,1,1},CombatTier::Ultimate},
    {199,1199,Stage::Ultimate,0,{0,0},10,50,"Monzaemon","neutral","Plush Paw","Bearhug Roll","Heartlight Beacon",nullptr,{200,38,35,39,48},{8,1,1,1,2},CombatTier::Ultimate},
    {200,1200,Stage::Ultimate,0,{0,0},10,50,"Mummymon","neutral","Bandage Hook","Sarcophagus Slam","Desert Hexbolt",nullptr,{200,38,35,39,48},{8,1,1,1,2},CombatTier::Ultimate},
    {201,1117,Stage::Ultimate,131,{244,0},10,50,"Paildramon","neutral","Dragon Gauntlet","Twinwing Collision","Desperado Starburst",nullptr,{176,44,38,45,39},{4,2,1,2,1},CombatTier::Ultimate},
    {202,1202,Stage::Ultimate,0,{0,0},10,50,"Parrotmon","grove","Emerald Beak","Jungle Wingbeat","Thunder Mimicry",nullptr,{176,35,35,57,39},{4,1,1,3,1},CombatTier::Ultimate},
    {203,1203,Stage::Ultimate,0,{0,0},10,50,"Piximon","grove","Pixie Spear","Fairy Vault","Bubble Rune Shower",nullptr,{176,35,35,57,39},{4,1,1,3,1},CombatTier::Ultimate},
    {204,1114,Stage::Ultimate,134,{255,0},10,50,"Rapidmon","grove","Emerald Cuff","Flashstep Ram","Guided Lightshot",nullptr,{176,44,38,45,39},{4,2,1,2,1},CombatTier::Ultimate},
    {205,1205,Stage::Ultimate,0,{0,0},10,50,"RizeGreymon","ember","Barrel Claw","Revolver Shoulder","Rising Plasma",nullptr,{176,56,38,36,36},{4,3,1,1,1},CombatTier::Ultimate},
    {206,1206,Stage::Ultimate,0,{0,0},10,50,"ShogunGekomon","tide","Toad Fan","Royal Bellypress","Resonant Reedcall",nullptr,{200,38,35,39,48},{8,1,1,1,2},CombatTier::Ultimate},
    {207,1097,Stage::Ultimate,123,{265,0},10,50,"Silphymon","grove","Sky Talon","Aerial Twinstrike","Cyclone Sigil",nullptr,{176,44,38,45,39},{4,2,1,2,1},CombatTier::Ultimate},
    {208,1208,Stage::Ultimate,0,{0,0},10,50,"SkullGreymon","ember","Bone Ripper","Fossil Stampede","Gravefire Rocket",nullptr,{176,56,38,36,36},{4,3,1,1,1},CombatTier::Ultimate},
    {209,1209,Stage::Ultimate,0,{0,0},10,50,"SuperStarmon","neutral","Astral Palm","Goldstar Bodyslam","Constellation Shieldray",nullptr,{200,38,35,39,48},{8,1,1,1,2},CombatTier::Ultimate},
    {210,1210,Stage::Ultimate,0,{0,0},10,50,"Triceramon","grove","Triple Horn Jab","Ceratopsian Charge","Granite Hornwave",nullptr,{200,38,47,39,36},{8,1,2,1,1},CombatTier::Ultimate},
    {211,1101,Stage::Ultimate,153,{249,0},10,50,"Tyilinmon","neutral","Cloudhoof Tap","Auspicious Bound","Luminous Qilin Seal",nullptr,{200,38,35,39,48},{8,1,1,1,2},CombatTier::Ultimate},
    {212,1095,Stage::Ultimate,139,{236,0},10,50,"WarGrowlmon","ember","Assault Claw","Reactor Bodyram","Crimson Plasma Jet",nullptr,{176,56,38,36,36},{4,3,1,1,1},CombatTier::Ultimate},
    {213,1089,Stage::Ultimate,150,{0,0},10,50,"Yatagaramon","neutral","Raven Claw","Threeclaw Plunge","Omen Featherstorm",nullptr,{176,35,35,57,39},{4,1,1,3,1},CombatTier::Ultimate},
    {214,1214,Stage::Mega,0,{0,0},15,80,"Armagemon","neutral","Fortress Pincer","Armageddon Bodypress","Apocalypse Webbeam",nullptr,{248,52,66,54,52},{8,1,2,1,1},CombatTier::Mega},
    {215,1215,Stage::Mega,0,{0,0},15,80,"Azulongmon","tide","Azure Whisker Lash","Celestial Dragon Coil","Eastern Thunderseal",nullptr,{248,52,50,54,68},{8,1,1,1,2},CombatTier::Mega},
    {216,1216,Stage::Mega,0,{0,0},15,80,"Babamon","grove","Broom Handle Tap","Elder Sweepfall","Hearth Blessing",nullptr,{248,52,50,54,68},{8,1,1,1,2},CombatTier::Mega},
    {217,1217,Stage::Mega,0,{0,0},15,80,"Baihumon","neutral","White Tiger Rend","Western Fangrush","Steel Roar Halo",nullptr,{216,76,54,50,52},{4,3,1,1,1},CombatTier::Mega},
    {218,1218,Stage::Mega,0,{0,0},15,80,"Barbamon","ember","Gilded Staffhook","Treasure Vault Crash","Avarice Emberseal",nullptr,{216,48,50,78,56},{4,1,1,3,1},CombatTier::Mega},
    {219,1219,Stage::Mega,0,{0,0},15,80,"Belphemon","neutral","Drowsy Claw","Slumbering Colossus","Nightmare Resonance",nullptr,{248,52,66,54,52},{8,1,2,1,1},CombatTier::Mega},
    {220,1220,Stage::Mega,0,{0,0},15,80,"BlackImperialdramon","neutral","Obsidian Dragon Rake","Black Citadel Charge","Eclipse Megaflare",nullptr,{248,52,66,54,52},{8,1,2,1,1},CombatTier::Mega},
    {221,1221,Stage::Mega,0,{0,0},15,80,"BlackMegaGargomon","neutral","Nightsteel Gauntlet","Dark Arsenal Stampede","Onyx Missile Rain",nullptr,{248,52,66,54,52},{8,1,2,1,1},CombatTier::Mega},
    {222,1222,Stage::Mega,0,{0,0},15,80,"BlackWarGreymon","neutral","Obsidian Dramon Claw","Black Tornado Drive","Dark Terra Sphere",nullptr,{216,76,54,50,52},{4,3,1,1,1},CombatTier::Mega},
    {223,1223,Stage::Mega,0,{0,0},15,80,"Cannondramon","ember","Gunmetal Tail","Artillery Bodyslam","Twin Siege Salvo",nullptr,{248,52,66,54,52},{8,1,2,1,1},CombatTier::Mega},
    {224,1224,Stage::Mega,0,{0,0},15,80,"ChaosGallantmon","neutral","Chaos Lancehook","Dark Knight Charge","Ruinshield Eclipse",nullptr,{216,48,50,78,56},{4,1,1,3,1},CombatTier::Mega},
    {225,1225,Stage::Mega,0,{0,0},15,80,"Cherubimon Vaccine","neutral","Merciful Palm","Sanctuary Bound","Golden Choir Halo",nullptr,{248,52,50,54,68},{8,1,1,1,2},CombatTier::Mega},
    {226,1226,Stage::Mega,0,{0,0},15,80,"Cherubimon Virus","neutral","Malice Talon","Nightmare Vault","Black Choir Storm",nullptr,{216,48,50,78,56},{4,1,1,3,1},CombatTier::Mega},
    {227,1227,Stage::Mega,0,{0,0},15,80,"Chronomon DM","ember","Doomwing Talon","Dark Chrono Dive","Eventide Timeflare",nullptr,{216,76,54,50,52},{4,3,1,1,1},CombatTier::Mega},
    {228,1228,Stage::Mega,0,{0,0},15,80,"Chronomon Holy Mode","neutral","Dawnwing Talon","Holy Chrono Descent","Timeless Aurora",nullptr,{248,52,50,54,68},{8,1,1,1,2},CombatTier::Mega},
    {229,1229,Stage::Mega,0,{0,0},15,80,"Creepymon","ember","Infernal Nail","Abyssal Wingcrash","Creeping Hellstar",nullptr,{216,48,50,78,56},{4,1,1,3,1},CombatTier::Mega},
    {230,1230,Stage::Mega,0,{0,0},15,80,"Crossmon","neutral","Crossmetal Talon","Golden Wingbreaker","Skyforge Radiance",nullptr,{216,76,54,50,52},{4,3,1,1,1},CombatTier::Mega},
    {231,1231,Stage::Mega,0,{0,0},15,80,"Daemon","ember","Cinder Scepter","Demon Mantle Rush","Dread Sovereign Sigil",nullptr,{248,52,50,54,68},{8,1,1,1,2},CombatTier::Mega},
    {232,1232,Stage::Mega,0,{0,0},15,80,"Darkdramon","neutral","Dark Lance Jab","Dreadnought Thrust","Abyss Energy Lance",nullptr,{216,76,54,50,52},{4,3,1,1,1},CombatTier::Mega},
    {233,1099,Stage::Mega,185,{0,0},15,80,"Diaboromon","neutral","Network Claw","Cable Webcrush","Kernel Collapse",nullptr,{216,48,50,78,56},{4,1,1,3,1},CombatTier::Mega},
    {234,1085,Stage::Mega,179,{0,0},15,80,"Dorugoramon","neutral","Primeval Doru Claw","Ironfur Cataclysm","Dragon Code Nova",nullptr,{216,76,54,50,52},{4,3,1,1,1},CombatTier::Mega},
    {235,1235,Stage::Mega,0,{0,0},15,80,"Ebonwumon","grove","Ancient Rootpress","Northern Shellquake","Evergreen Twinlight",nullptr,{248,52,66,54,52},{8,1,2,1,1},CombatTier::Mega},
    {236,1095,Stage::Mega,212,{0,0},15,80,"Gallantmon","ember","Crimson Lance","Royal Shieldcharge","Radiant Javelin",nullptr,{216,60,54,62,56},{4,2,1,2,1},CombatTier::Mega},
    {237,1237,Stage::Mega,0,{0,0},15,80,"Gallantmon Crimson Mode","ember","Crimson Wingblade","Scarlet Knightfall","Royal Star Ignition",nullptr,{216,76,54,50,52},{4,3,1,1,1},CombatTier::Mega},
    {238,1238,Stage::Mega,0,{0,0},15,80,"Ghoulmon","neutral","Spectral Grasp","Phantom Wingpress","Pale Eye Eclipse",nullptr,{216,48,50,78,56},{4,1,1,3,1},CombatTier::Mega},
    {239,1239,Stage::Mega,0,{0,0},15,80,"Ghoulmon Black","neutral","Obsidian Grasp","Black Phantom Descent","Umbral Eye Lantern",nullptr,{248,52,50,54,68},{8,1,1,1,2},CombatTier::Mega},
    {240,1080,Stage::Mega,196,{0,0},15,80,"GigaSeadramon","tide","Battleship Fin","Giga Hullcrash","Ocean Missile Array",nullptr,{248,52,66,54,52},{8,1,2,1,1},CombatTier::Mega},
    {241,1241,Stage::Mega,0,{0,0},15,80,"Granlocomon","ember","Locomotive Ram","Grand Railbreaker","Furnace Railbeam",nullptr,{248,52,66,54,52},{8,1,2,1,1},CombatTier::Mega},
    {242,1242,Stage::Mega,0,{0,0},15,80,"GuardiAngemon","neutral","Guardian Blade","Sanctified Bladefall","Silver Gate Radiance",nullptr,{248,52,50,54,68},{8,1,1,1,2},CombatTier::Mega},
    {243,1096,Stage::Mega,166,{0,0},15,80,"HiAndromon","neutral","Titanium Knuckle","Precision Piston Slam","Optimizer Beam",nullptr,{248,52,66,54,52},{8,1,2,1,1},CombatTier::Mega},
    {244,1117,Stage::Mega,201,{0,0},15,80,"Imperialdramon Dragon Mode","ember","Imperial Dragon Claw","Dragon Citadel Dive","Positron Sunflare",nullptr,{248,52,66,54,52},{8,1,2,1,1},CombatTier::Mega},
    {245,1245,Stage::Mega,0,{0,0},15,80,"Imperialdramon Fighter Mode","ember","Imperial Fistblade","Fighter Mode Blitz","Positron Starburst",nullptr,{216,60,54,62,56},{4,2,1,2,1},CombatTier::Mega},
    {246,1246,Stage::Mega,0,{0,0},15,80,"Imperialdramon Paladin Mode","neutral","Paladin Swordarc","White Knight Descent","Omega Dawnseal",nullptr,{248,52,50,54,68},{8,1,1,1,2},CombatTier::Mega},
    {247,1247,Stage::Mega,0,{0,0},15,80,"Jijimon","grove","Elder Staff Tap","Wisdom Cane Crush","Ancient Hearthstar",nullptr,{216,48,50,78,56},{4,1,1,3,1},CombatTier::Mega},
    {248,1248,Stage::Mega,0,{0,0},15,80,"Justimon","neutral","Justice Knuckle","Heroic Rocketheel","Trinity Voltage",nullptr,{216,76,54,50,52},{4,3,1,1,1},CombatTier::Mega},
    {249,1101,Stage::Mega,211,{0,0},15,80,"Kentaurosmon","tide","Aurora Hoofstrike","Sixleg Shieldrush","Northern Light Arrow",nullptr,{248,52,50,54,68},{8,1,1,1,2},CombatTier::Mega},
    {250,1250,Stage::Mega,0,{0,0},15,80,"Leviamon","tide","Abyss Crocodile Bite","Tsunami Jawpress","Envious Ocean Roar",nullptr,{248,52,66,54,52},{8,1,2,1,1},CombatTier::Mega},
    {251,1251,Stage::Mega,0,{0,0},15,80,"Lilithmon","neutral","Tempting Nail","Velvet Wingfall","Violet Sinmist",nullptr,{216,48,50,78,56},{4,1,1,3,1},CombatTier::Mega},
    {252,1252,Stage::Mega,0,{0,0},15,80,"Machinedramon","ember","Foundry Claw","Iron Fortress Trample","Infinity Furnace",nullptr,{248,52,66,54,52},{8,1,2,1,1},CombatTier::Mega},
    {253,1253,Stage::Mega,0,{0,0},15,80,"MaloMyotismon","neutral","Crimson Doomclaw","Nightlord Wingcrush","Pandemonium Lantern",nullptr,{216,48,50,78,56},{4,1,1,3,1},CombatTier::Mega},
    {254,1254,Stage::Mega,0,{0,0},15,80,"MarineAngemon","tide","Tiny Ocean Nudge","Bubble Halo Roll","Peaceful Tideheart",nullptr,{248,52,50,54,68},{8,1,1,1,2},CombatTier::Mega},
    {255,1114,Stage::Mega,204,{0,0},15,80,"MegaGargomon","grove","Green Arsenal Fist","Heavy Rabbit Stampede","Emerald Rocket Bloom",nullptr,{248,52,66,54,52},{8,1,2,1,1},CombatTier::Mega},
    {256,1256,Stage::Mega,0,{0,0},15,80,"MetalEtemon","neutral","Chrome Stage Fist","Platinum Encore Slam","Metal Feedback Wave",nullptr,{248,52,66,54,52},{8,1,2,1,1},CombatTier::Mega},
    {257,1080,Stage::Mega,196,{0,0},15,80,"MetalSeadramon","tide","Alloy Serpent Bite","Iron Tidal Coil","Deepsea Reactor Ray",nullptr,{248,52,66,54,52},{8,1,2,1,1},CombatTier::Mega},
    {258,1258,Stage::Mega,0,{0,0},15,80,"Neptunemon","tide","Trident Hook","Ocean King Thrust","Sovereign Whirlpool",nullptr,{216,60,54,62,56},{4,2,1,2,1},CombatTier::Mega},
    {259,1259,Stage::Mega,0,{0,0},15,80,"Omnimon","neutral","Twin Knight Slash","United Swordrush","Transcendent Cannon",nullptr,{216,60,54,62,56},{4,2,1,2,1},CombatTier::Mega},
    {260,1260,Stage::Mega,0,{0,0},15,80,"Parasimon","grove","Parasite Needle","Tendril Hostcrush","Spore Command",nullptr,{216,48,50,78,56},{4,1,1,3,1},CombatTier::Mega},
    {261,1081,Stage::Mega,183,{0,0},15,80,"Phoenixmon","ember","Phoenix Talon","Rebirth Wingpress","Sacred Cinder Halo",nullptr,{248,52,50,54,68},{8,1,1,1,2},CombatTier::Mega},
    {262,1262,Stage::Mega,0,{0,0},15,80,"Piedmon","neutral","Jester Rapier","Acrobat Bladefall","Masquerade Mirage",nullptr,{216,48,50,78,56},{4,1,1,3,1},CombatTier::Mega},
    {263,1263,Stage::Mega,0,{0,0},15,80,"PrinceMamemon","neutral","Royal Little Jab","Crown Knuckle Rush","Gilded Bubble Parade",nullptr,{216,60,54,62,56},{4,2,1,2,1},CombatTier::Mega},
    {264,1264,Stage::Mega,0,{0,0},15,80,"SaberLeomon","grove","Saber Fang Rake","Primeval Lion Pounce","Golden Mane Roar",nullptr,{216,76,54,50,52},{4,3,1,1,1},CombatTier::Mega},
    {265,1097,Stage::Mega,207,{0,0},15,80,"Valkyrimon","tide","Valkyrie Swordcut","Battlemaiden Swordfall","Runic Winter Arrow",nullptr,{216,76,54,50,52},{4,3,1,1,1},CombatTier::Mega},
    {266,1266,Stage::Mega,0,{0,0},15,80,"Varodurumon","neutral","Radiant Feather Sweep","Sixwing Skypress","Purifying Dawnlight",nullptr,{248,52,50,54,68},{8,1,1,1,2},CombatTier::Mega},
    {267,1267,Stage::Mega,0,{0,0},15,80,"Zhuqiaomon","ember","Vermilion Beak","Southern Wingcrash","Sovereign Firewheel",nullptr,{216,48,50,78,56},{4,1,1,3,1},CombatTier::Mega},
    {268,1268,Stage::Armor,0,{0,0},5,20,"Flamedramon","ember","Fire Gauntlet","Blazing Armor Rush","Flame Crest Spiral",nullptr,{136,36,24,23,23},{4,3,1,1,1},CombatTier::Champion},
    {269,1269,Stage::Armor,0,{0,0},5,20,"Kenkimon","neutral","Excavator Hook","Digger Chassis Ram","Quarry Dustbeam",nullptr,{152,24,30,25,23},{8,1,2,1,1},CombatTier::Champion},
    {270,1270,Stage::Armor,0,{0,0},5,20,"Kongoumon","grove","Golden Beetle Palm","Diamond Shellpress","Vajra Pollen Spark",nullptr,{152,24,30,25,23},{8,1,2,1,1},CombatTier::Champion},
    {271,1271,Stage::Armor,0,{0,0},5,20,"Magnamon","neutral","Golden Guardfist","Miracle Armor Charge","Radiant Crestburst",nullptr,{152,24,22,25,31},{8,1,1,1,2},CombatTier::Champion},
    {272,1272,Stage::Armor,0,{0,0},5,20,"Ponchomon","grove","Maraca Tap","Poncho Spinpress","Cactus Festival Mist",nullptr,{136,22,22,37,25},{4,1,1,3,1},CombatTier::Champion},
    {273,1273,Stage::Armor,0,{0,0},5,20,"Prairiemon","grove","Prairie Claw","Burrow Shouldercharge","Dustgrass Spiral",nullptr,{136,36,24,23,23},{4,3,1,1,1},CombatTier::Champion},
    {274,1274,Stage::Armor,0,{0,0},5,20,"Seahomon","tide","Coral Tailflick","Reefcoil Tackle","Seahorse Crestlight",nullptr,{152,24,22,25,31},{8,1,1,1,2},CombatTier::Champion},
    {275,1275,Stage::Armor,0,{0,0},5,20,"Shurimon","grove","Leaf Shuriken","Pinwheel Heelrush","Verdant Ninja Gust",nullptr,{136,36,24,23,23},{4,3,1,1,1},CombatTier::Champion},
    {276,1276,Stage::NoLevel,0,{0,0},1,0,"Calumon","neutral","Playful Ear Tap","Tumbling Somersault","Gentle Crestglow",nullptr,{112,16,13,16,16},{8,1,1,1,2},CombatTier::Rookie},
